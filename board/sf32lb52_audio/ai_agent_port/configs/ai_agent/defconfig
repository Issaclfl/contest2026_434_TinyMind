## board/sf32lb52_net/esp32s3_common/components/espllm/Kconfig
```kconfig
menu "Local model node (espllm)"

    config ESPLM_MODEL_ID
        string "Model name reported over the API"
        default "stories260K"
        help
            Reported by GET /v1/models and echoed in chat completions.  It is
            what a client's `set_llm <host> <model> <key>` can put in the model
            field; nothing matches on it.

    config ESPLM_TEMPERATURE
        int "Temperature x100 (0 = greedy)"
        range 0 200
        default 90

    config ESPLM_TOPP
        int "Top-p x100"
        range 1 100
        default 90

    config ESPLM_SEED
        int "RNG seed"
        default 1337

    config ESPLM_HTTP_PORT
        int "HTTP port for the OpenAI-compatible API"
        default 80

    config ESPLM_HTTP_MAX_TOKENS
        int "Tokens per request when the client does not ask for a count"
        range 8 1024
        default 120

    config ESPLM_TOKENS_LIMIT
        int "Upper bound on a client's max_tokens"
        range 8 1024
        default 256
        help
            A cap matters here: on this hardware generation runs at ~20 tok/s,
            so a client asking for 1000 tokens would hold the HTTP task for
            almost a minute.

    config ESPLM_HTTP_TASK_STACK
        int "HTTP task stack size (generation runs on it)"
        default 32768

endmenu
```

## board/sf32lb52_net/esp32s3_gateway/main/Kconfig.projbuild
```kconfig
menu "SF32LB52 gateway"

    config GATEWAY_ASR_MODEL
        string "Model used to transcribe voice commands"
        default "mimo-v2.5-asr"
        help
            The voice route sends the recorded audio to this model at the same
            endpoint as the chat route.  Two things are worth knowing:
              * the ASR model wants an **audio-only** request: sending a text
                prompt alongside the audio is rejected ("ASR request must not
                include text parts"), so voice_exec.c sends the audio alone;
              * using the general chat model instead also works but spends
                7-8 s thinking before it transcribes, against 1.6 s for this
                one (both measured, see the evidence doc §十一).

    config GATEWAY_VOICE_TLS_PORT
        int "TLS port for the voice page"
        default 443
        help
            The same routes that listen on the plain HTTP port are served again
            over TLS here.  This is not decoration: a browser only hands out the
            microphone to a secure origin, so on http://<gateway>/talk
            navigator.mediaDevices is undefined and the hold-to-talk button does
            nothing at all (measured: window.isSecureContext === false, and a
            console line "Cannot read properties of undefined (reading
            'getUserMedia')").  The board's agent keeps using the plain-HTTP leg
            at http://10.0.0.1/v1, so both ports stay up.

            The certificate is self-signed: the browser asks once and the page
            works after "proceed anyway".  See ../README.md.

    config GATEWAY_CMD_LED
        bool "Let the command model drive the onboard RGB led"
        default y
        help
            The local command model can emit {"action":"led","color":...} and
            the gateway then drives the board's addressable RGB led (a WS2812
            on the DevKitC-1, driven through RMT).  Turn this off on hardware
            without one: the action still parses and still reports, it just
            says the led is disabled.

    config GATEWAY_LED_GPIO
        int "GPIO of the onboard addressable led"
        default 48
        range 0 48
        help
            ESP32-S3-DevKitC-1 revisions differ here: rev 1.1 wires the RGB led
            to GPIO48, earlier revisions to GPIO38.  If the led action reports
            success but nothing lights up, try 38 -- that is the honest way to
            find out which board this is, since the LED gives no readback.

    config GATEWAY_UPLINK
        bool "Bring up Wi-Fi and NAT the board out to the internet"
        default y
        help
            Turn this off to bench-test the PPP link on its own: the gateway
            then runs the PPP server with no Wi-Fi and no NAPT, which is how
            you tell "the peer does not negotiate PPP with us" apart from
            "NAT is not routing it".  In that mode the board can reach this
            device but nothing beyond it unless something else (for example
            the PC-side ppp_up.sh) provides the route out.

    config GATEWAY_WIFI_SSID
        string "Wi-Fi SSID"
        default ""
        help
            Deliberately empty here.  Enter the real value through
            `idf.py menuconfig`: it is stored in sdkconfig, which .gitignore
            excludes.  This repository is public, so credentials never belong
            in a committed file.

    config GATEWAY_WIFI_PASSWORD
        string "Wi-Fi password"
        default ""

    config GATEWAY_WIFI_MAX_RETRY
        int "Wi-Fi reconnect attempts before giving up (0 = retry forever)"
        default 0

    config GATEWAY_UART_PORT
        int "UART port carrying the PPP link"
        range 0 2
        default 1
        help
            UART0 is the console.  UART1 is the default because its IOMUX pins
            (GPIO17/18) need no extra routing.

    config GATEWAY_UART_TX_GPIO
        int "UART TX GPIO (ESP32-S3 -> board UART2 RX / PA20)"
        default 17

    config GATEWAY_UART_RX_GPIO
        int "UART RX GPIO (board UART2 TX / PA27 -> ESP32-S3)"
        default 18

    config GATEWAY_UART_BAUD
        int "UART baud rate"
        range 9600 3000000
        default 460800
        help
            Must match the rate the board's pppd is told to use, e.g.
            `pppd /dev/ttyS0 460800`.  The board's UART driver accepts only
            8 data bits, no parity, one stop bit.

    config GATEWAY_PPP_OUR_IP
        string "Address the gateway keeps for itself"
        default "10.0.0.1"

    config GATEWAY_PPP_PEER_IP
        string "Address assigned to the board"
        default "10.0.0.2"

    config GATEWAY_PPP_DNS
        string "DNS server advertised to the peer"
        default "223.5.5.5"
        help
            Advisory only.  The board's pppd ignores IPCP DNS options and uses
            the server compiled into its own defconfig.

    config GATEWAY_PPP_PASSIVE
        bool "Wait for the peer to start LCP (ppp_listen) instead of dialling out"
        default y
        help
            The board's pppd is the active side, so the gateway should listen.
            Confirmed on hardware (2026-09-18 bench test): with this left at y
            the NuttX pppd initiated, LCP and IPCP completed, and ping ran at
            5/5 with zero loss.  No need to change it.

    config GATEWAY_NO_SESSION_HINT_SEC
        int "Seconds without a session before printing a hint"
        range 5 600
        default 30

    config GATEWAY_REARM_SEC
        int "Seconds between attempts to re-arm a dead PPP session"
        range 5 3600
        default 20

    config GATEWAY_LOCAL_LLM
        bool "Also run a local llama2.c model and serve it over HTTP"
        default y
        help
            The gateway then answers OpenAI-compatible requests at
            http://<its address>/v1 -- on the PPP link for the board, and on
            Wi-Fi for anything else.  It is the offline fallback: the model is
            small and the answers are simple, but they come from this device
            with no internet involved.

            Memory: the weights are copied into PSRAM at boot (~1 MB for
            stories260K, plus ~640 KB of KV cache).  Turn this off to get the
            PSRAM back and keep the gateway purely a router.

    config GATEWAY_LLM_PART_NAME
        string "Partition holding the packed model"
        depends on GATEWAY_LOCAL_LLM
        default "llm"

    config GATEWAY_LLM_PART_SUBTYPE
        hex "Subtype of that partition"
        depends on GATEWAY_LOCAL_LLM
        default 0x40

    config GATEWAY_CLOUD_URL
        string "Cloud LLM chat-completions URL"
        default "https://token-plan-cn.xiaomimimo.com/v1/chat/completions"
        help
            Where requests the local model should not answer are proxied to.
            The default is the endpoint the official agent uses; any
            OpenAI-compatible one works.  The URL is not a secret; the key is.

    config GATEWAY_CLOUD_MODEL
        string "Model name sent to the cloud LLM"
        default "mimo-v2.5-pro"
        help
            The board names its route ("auto"); this is the name the cloud
            gets instead.  The body's model field is rewritten in transit.

    config GATEWAY_CLOUD_API_KEY
        string "Cloud LLM API key"
        default ""
        help
            Deliberately empty here, like the Wi-Fi credentials: enter the
            real value through tools/set_cloud.py (no echo) or menuconfig.
            It is stored in sdkconfig, which .gitignore excludes -- this
            repository is public and it is never logged or served.

    config GATEWAY_CLOUD_TIMEOUT_MS
        int "Cloud call timeout (ms)"
        range 5000 120000
        default 45000
        help
            The board's agent waits 60 s per attempt and retries, so a cloud
            answer that needs longer than this is useless even if it arrives.
            When the uplink is gone the connect fails in seconds and the
            fallback happens long before this expires.

    config GATEWAY_CLOUD_MAX_RESP
        int "Largest accepted cloud answer (bytes)"
        range 8192 262144
        default 65536

endmenu

config GATEWAY_MIIO_TABLE
    string "米家设备表（name,ip,token,model;...）"
    default ""
    help
        局域网里的米家设备。token 是设备凭据，只允许写在被 gitignore 的
        sdkconfig 里（tools/set_miio.py 负责写入），不要进仓库、不要进日志。
        例：lamp,192.168.1.23,0123456789abcdef0123456789abcdef,yeelink.light.color3;
```

## board/sf32lb52_net/esp32s3_llm/main/Kconfig.projbuild
```kconfig
menu "Local model demo"

    config LLM_PROMPT
        string "Prompt used at boot"
        default "One day, a little girl"

    config LLM_MAX_TOKENS
        int "Tokens to generate per round"
        range 8 1024
        default 160

    config LLM_ROUNDS
        int "Rounds to run at boot (each one re-generates)"
        range 1 100
        default 2

endmenu
```
